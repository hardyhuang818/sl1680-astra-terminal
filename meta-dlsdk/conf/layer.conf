## meta-dlsdk/conf/layer.conf
```bitbake
# meta-dlsdk — DisplayLink SDK (DL-3xxx..DL-7xxx) for Astra SL1680
BBPATH .= ":${LAYERDIR}"

BBFILES += "${LAYERDIR}/recipes-*/*/*.bb \
            ${LAYERDIR}/recipes-*/*/*.bbappend \
            ${LAYERDIR}/recipes-*/*/*/*.bb \
            ${LAYERDIR}/recipes-*/*/*/*.bbappend"

BBFILE_COLLECTIONS += "dlsdk"
BBFILE_PATTERN_dlsdk = "^${LAYERDIR}/"
BBFILE_PRIORITY_dlsdk = "10"

LAYERDEPENDS_dlsdk = "core"
LAYERSERIES_COMPAT_dlsdk = "scarthgap"
```
